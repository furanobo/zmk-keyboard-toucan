## Kconfig
```kconfig
config ZMK_INPUT_PROCESSOR_SPEED_STEP
    bool "Adjustable speed step input processor"
    default y
    depends on ZMK_POINTING
    depends on DT_HAS_ZMK_INPUT_PROCESSOR_SPEED_STEP_ENABLED

config ZMK_BEHAVIOR_SPEED_STEP
    bool "Speed step adjustment behavior"
    default y
    depends on ZMK_INPUT_PROCESSOR_SPEED_STEP
    depends on DT_HAS_ZMK_BEHAVIOR_SPEED_STEP_ENABLED
```

## dts/bindings/behaviors/zmk,behavior-speed-step.yaml
```yaml
# Copyright (c) 2024 The ZMK Contributors
# SPDX-License-Identifier: MIT

description: |
  Behavior to adjust the speed level of a speed step input processor.
  Use with SPEED_STEP_UP (0) or SPEED_STEP_DN (1) as the parameter.

compatible: "zmk,behavior-speed-step"

properties:
  "#binding-cells":
    type: int
    required: true
    const: 1

  processor:
    type: phandle
    required: true
    description: Reference to the speed step input processor to control

binding-cells:
  - param1
```

## dts/bindings/input_processors/zmk,input-processor-gesture.yaml
```yaml
# Copyright (c) 2024 The ZMK Contributors
# SPDX-License-Identifier: MIT

description: |
  Multitouch gesture input processor.
  Detects tap, multi-tap, and swipe gestures from trackpad input events.
  Single tap emits left click, double tap emits right click,
  triple tap emits middle click. Swipe gestures are logged and
  can be mapped to actions.

compatible: "zmk,input-processor-gesture"

properties:
  "#input-processor-cells":
    type: int
    required: true
    const: 0

  tap-timeout-ms:
    type: int
    default: 200
    description: |
      Maximum touch duration (ms) for a gesture to count as a tap.
      Touches longer than this are treated as movement, not taps.

  tap-threshold:
    type: int
    default: 50
    description: |
      Maximum accumulated movement (sum of abs X + abs Y) during a touch
      for it to qualify as a tap. Higher values are more forgiving of
      finger movement during a tap.

  double-tap-window-ms:
    type: int
    default: 250
    description: |
      Maximum time window (ms) between consecutive taps to count as
      a multi-tap gesture (double tap, triple tap).

  swipe-threshold:
    type: int
    default: 300
    description: |
      Minimum accumulated movement in the dominant direction for a
      touch to qualify as a swipe gesture.

  touch-idle-timeout-ms:
    type: int
    default: 80
    description: |
      Time without input events (ms) before a touch is considered ended.
      Lower values make tap detection faster but may cause false
      touch-end detection on slow movements.
```

## dts/bindings/input_processors/zmk,input-processor-speed-step.yaml
```yaml
# Copyright (c) 2024 The ZMK Contributors
# SPDX-License-Identifier: MIT

description: |
  Adjustable speed step input processor.
  Scales input event values by a runtime-selectable multiplier from a
  configurable list of speed levels. The current level persists across
  power cycles via Zephyr settings subsystem.

compatible: "zmk,input-processor-speed-step"

properties:
  "#input-processor-cells":
    type: int
    required: true
    const: 0

  type:
    type: int
    required: true
    description: Input event type to process (e.g. INPUT_EV_REL)

  codes:
    type: array
    required: true
    description: Input event codes to process (e.g. INPUT_REL_X, INPUT_REL_Y)

  speed-multipliers:
    type: array
    required: true
    description: |
      Array of speed multipliers. Each value is divided by speed-divisor
      to get the actual scaling factor.

  speed-divisor:
    type: int
    default: 100
    description: Common divisor for all speed multipliers (default 100)

  default-level:
    type: int
    required: true
    description: Default speed level index (0-based)

  settings-name:
    type: string
    required: true
    description: |
      Unique short name for persistent settings key (e.g. "ms" for mouse speed).
      Settings are stored under "spd/<settings-name>".

  track-remainders:
    type: boolean
    description: Track fractional remainders across events for sub-pixel accuracy
```
